## Kconfig
```kconfig
# TuringOS Driver Configuration
#
# This is the top-level Kconfig for the TuringOS driver menuconfig system.
# It sources all driver package Kconfig.L4 files and provides simple
# enable/disable switches for packages without their own Kconfig.L4.

mainmenu "TuringOS Driver Configuration"

# ---- Packages with existing Kconfig.L4 ----

comment "--- Core Components ---"

source "pkg/bootstrap/Kconfig.turingos"

source "pkg/cons/Kconfig.L4"

source "pkg/drivers-frst/Kconfig.L4"

source "pkg/tinit/Kconfig.L4"

comment "--- Storage Drivers ---"

source "pkg/emmc-driver/Kconfig.L4"

comment "--- Bus & Peripheral Drivers ---"

source "pkg/i2c-driver/Kconfig.L4"

source "pkg/spi-driver/Kconfig.L4"

source "pkg/io/Kconfig.turingos"

source "pkg/rtc/Kconfig.L4"

comment "--- Device Drivers ---"

source "pkg/ssd1306/Kconfig.L4"

comment "--- Virtualization ---"

source "pkg/uvmm/Kconfig.L4"

source "pkg/tvmm/Kconfig.L4"

source "pkg/virtio-net-switch/Kconfig.L4"

comment "--- Packages without detailed Kconfig ---"

menu "Additional driver packages"

config PKG_ACPICA
	bool "acpica - ACPI Component Architecture"
	default n
	help
	  ACPI Component Architecture library. Required for ACPI support
	  on x86/amd64 and optionally on arm64 platforms.

config PKG_ADA
	bool "ada - Ada runtime support"
	default n

config PKG_AHCI_DRIVER
	bool "ahci-driver - AHCI/SATA disk driver"
	default n
	help
	  AHCI controller driver for SATA disk access.

config PKG_ATKINS
	bool "atkins - Atkins test framework"
	default n

config PKG_BCM2835_MBOX_DRIVER
	bool "bcm2835-mbox-driver - Raspberry Pi mailbox driver"
	default y
	help
	  Mailbox driver for Raspberry Pi (BCM2835/BCM2711).
	  Required by emmc-driver for RPi SD card support.

config PKG_GNU_EFI
	bool "gnu-efi - GNU EFI library"
	default n

config PKG_HELLO
	bool "hello - Hello world example"
	default n

config PKG_L4VIRTIO
	bool "l4virtio - L4 Virtio support library"
	default n
	help
	  Virtio transport library for L4Re. Required by virtio-based
	  drivers and virtual machine monitors.

config PKG_LIBBLOCK_DEVICE
	bool "libblock-device - Block device library"
	default n
	help
	  Common block device abstraction library used by storage drivers.

config PKG_LIBFDT
	bool "libfdt - Flattened Device Tree library"
	default n
	help
	  Library for parsing and manipulating Flattened Device Trees (FDT/DTB).

config PKG_LIBVCPU
	bool "libvcpu - Virtual CPU library"
	default n
	help
	  Library for virtual CPU management. Used by virtual machine monitors.

config PKG_NATIVE_SHELL
	bool "native_shell - Interactive shell"
	default y
	select PKG_READLINE
	help
	  Serial-interactive shell with readline support.

config PKG_NVME_DRIVER
	bool "nvme-driver - NVMe disk driver"
	default n
	help
	  NVMe controller driver for NVMe SSD access.

config PKG_READLINE
	bool "readline - Line editing library"
	default n

config PKG_VIRTIO_NET
	bool "virtio-net - Virtio network driver"
	default n
	help
	  Virtio network device driver.

config PKG_ZLIB
	bool "zlib - Compression library"
	default n
	help
	  ZLIB compression/decompression library. Required for compressed
	  bootstrap modules and uvmm gzip loader.

endmenu
```

## defconfig
```kconfig
#
# TuringOS Default Configuration - Raspberry Pi 4B
#

#
# Bootstrap
#
# CONFIG_BOOTSTRAP_ROOTTASK_NX is not set
# CONFIG_BOOTSTRAP_THUMB_ENTRY is not set
# CONFIG_BOOTSTRAP_COMPRESS is not set
# CONFIG_BOOTSTRAP_CHECK_MD5 is not set

#
# Console multiplexer
#
# CONFIG_CONS_USE_ASYNC_FE is not set

#
# UART drivers
#
CONFIG_DRIVERS_FRST_UART_ALL_DRIVERS=y

#
# Tiny system loader
#
CONFIG_TINIT_VERBOSITY_INFO=y
CONFIG_TINIT_RUN_ROOTTASK=y
CONFIG_TINIT_HEAP_SIZE=1024
CONFIG_TINIT_MAP_DEBUG_CAP=y
CONFIG_TINIT_DYNAMIC_LOADER=y

#
# eMMC driver - enable BCM2711 for RPi4 SD card
#
CONFIG_EMMC_DRV_SDHCI_BCM2711=y
CONFIG_EMMC_DRV_SDHCI_USDHC=y
CONFIG_EMMC_DRV_SDHCI_PLAIN=y
CONFIG_EMMC_DRV_SDHI_RCAR3=y
# CONFIG_EMMC_DRV_SDHI_RCAR3_EMU is not set

#
# I2C driver
#
CONFIG_I2C_DRIVER_RPI4=y
# CONFIG_I2C_DRIVER_IMX8 is not set

#
# io platform manager
#
# CONFIG_L4IO_ACPI is not set
CONFIG_L4IO_PCI=y
CONFIG_L4IO_PCIID_DB=y
# CONFIG_L4IO_PCI_SRIOV is not set
CONFIG_L4IO_SCU_IMX8QM=y
CONFIG_L4IO_IOMUXC_IMX8MP=y
CONFIG_L4IO_GPIO_BCM2835=y
CONFIG_L4IO_GPIO_OMAP=y
CONFIG_L4IO_GPIO_QCOM=y
CONFIG_L4IO_GPIO_IMX=y

#
# RTC
#
# CONFIG_RTC_DS3231 is not set
# CONFIG_RTC_PCF85063A is not set

#
# uvmm - disabled by default for basic RPi4 setup
#
# CONFIG_UVMM_MONITOR is not set

#
# tvmm - disabled (ARM32 only)
#

#
# Virtual network switch
#
# CONFIG_VNS_PORT_FILTER is not set
# CONFIG_VNS_IXL is not set
# CONFIG_VNS_STATS is not set

#
# Additional driver packages
#
# CONFIG_PKG_ACPICA is not set
# CONFIG_PKG_ADA is not set
# CONFIG_PKG_AHCI_DRIVER is not set
# CONFIG_PKG_ATKINS is not set
CONFIG_PKG_BCM2835_MBOX_DRIVER=y
# CONFIG_PKG_GNU_EFI is not set
# CONFIG_PKG_HELLO is not set
# CONFIG_PKG_L4VIRTIO is not set
CONFIG_PKG_LIBBLOCK_DEVICE=y
# CONFIG_PKG_LIBFDT is not set
# CONFIG_PKG_LIBVCPU is not set
# CONFIG_PKG_NVME_DRIVER is not set
# CONFIG_PKG_READLINE is not set
# CONFIG_PKG_VIRTIO_NET is not set
# CONFIG_PKG_ZLIB is not set
```

## pkg/bootstrap/server/src/platform/Kconfig.s32z
```kconfig
# S32Z platform configuration
# Disabled: choice blocks incompatible with kconfig 6.18+
# Original upstream uses if/choice syntax not supported by newer kconfig parsers.

if PLATFORM_TYPE_s32z

config BOOTSTRAP_PF_S32Z_DYN_ALLOC_OVERRIDE
	bool "Override dynamic allocation region"
	help
	  Specify region of dynamic allocations manually. By default the whole
	  CRAM region of the respective cluster is used.

config BOOTSTRAP_PF_S32Z_DYN_ALLOC_START
	hex "Dynamic alloction base address"
	depends on BOOTSTRAP_PF_S32Z_DYN_ALLOC_OVERRIDE
	default 0x32100000
	help
	  Lower address of region where dynamic allocations are done. This
	  includes the multiboot information and possibly dynamic placement
	  of the initial tasks.

config BOOTSTRAP_PF_S32Z_DYN_ALLOC_END
	hex "Dynamic allocations end address"
	depends on BOOTSTRAP_PF_S32Z_DYN_ALLOC_OVERRIDE
	default 0x327fffff
	help
	  Upper address (inclusive) of region where dynamic allocations are
	  done.

endif
```

## pkg/devices/ssd1306/Kconfig.L4
```kconfig
menu "SSD1306 OLED display driver"

config SSD1306
	bool "Enable SSD1306 OLED display driver (SPI)"
	default y
	help
	  SSD1306-based OLED display driver over SPI.
	  Supports 128x64 and 128x32 display variants.

if SSD1306

choice
	prompt "Display resolution"
	default SSD1306_128X64

config SSD1306_128X64
	bool "128x64"
	help
	  Standard 128x64 pixel OLED display.

config SSD1306_128X32
	bool "128x32"
	help
	  Smaller 128x32 pixel OLED display.

endchoice

config SSD1306_HEIGHT
	int
	default 64 if SSD1306_128X64
	default 32 if SSD1306_128X32

choice
	prompt "SPI controller backend"
	default SSD1306_SPI_BCM2835

config SSD1306_SPI_BCM2835
	bool "BCM2835 (Raspberry Pi)"
	depends on SPI_DRIVER_RPI4
	help
	  Use the BCM2835 SPI controller on Raspberry Pi.

config SSD1306_SPI_IMX8
	bool "i.MX8 eCSPI"
	depends on SPI_DRIVER_IMX8
	help
	  Use the i.MX8 eCSPI controller.

config SSD1306_SPI_AM335X
	bool "AM335x McSPI (BeagleBone Black)"
	depends on SPI_DRIVER_AM335X
	help
	  Use the TI AM335x McSPI controller on BeagleBone Black.

endchoice

config SSD1306_SPI_CS
	int "SPI chip-select (CS) number"
	range 0 3
	default 0
	help
	  Which SPI chip-select line the display is wired to.

config SSD1306_SPI_MODE
	int "SPI mode (0-3)"
	range 0 3
	default 0
	help
	  SPI clock polarity/phase mode.
	  Mode 0 (CPOL=0, CPHA=0) is the most common for SSD1306.

config SSD1306_SPI_SPEED_KHZ
	int "SPI clock speed (kHz)"
	range 100 20000
	default 8000
	help
	  SPI bus clock frequency in kHz.
	  SSD1306 supports up to ~10 MHz; default is 8 MHz.

config SSD1306_DC_PIN
	int "D/C (Data/Command) GPIO pin number"
	range 0 255
	default 25
	help
	  GPIO pin number used for the Data/Command signal.
	  Low = command, High = data.

config SSD1306_CONTRAST
	int "Default contrast (0-255)"
	range 0 255
	default 207
	help
	  Initial display contrast value (0xCF = 207).

config SSD1306_BUILD_EXAMPLE
	bool "Build ssd1306-example demo program"
	default y
	help
	  Build the demonstration program that draws text and
	  geometric shapes on the display.

endif # SSD1306

endmenu
```

## pkg/drivers/bootstrap/Kconfig.turingos
```kconfig
# Wrapper Kconfig for bootstrap that resolves relative source paths
# to absolute paths for standalone menuconfig usage.

menu "Bootstrap"

config BOOTSTRAP_ROOTTASK_NX
	bool "Support W^X in the root task"
	help
	  Mark the text sections of the root task as non-writeable in the memory
	  map and mark the data sections as non executable.

	  If in doubt, choose n.

config BOOTSTRAP_THUMB_ENTRY
	bool "Thumb mode entry point"
	depends on BUILD_ARCH_arm
	help
	  Assume that bootstrap is started in Thumb mode.

	  If in doubt, choose n.

config BOOTSTRAP_COMPRESS
	bool "Support for compressed modules"
	depends on HAVE_BIDPC_ZLIB
	help
	  Allow bootstrap to decompress modules that have been compressed.

config BOOTSTRAP_CHECK_MD5
	bool "Enable module integrity check (MD5)"
	depends on HAVE_BIDPC_LIBBSD_LITE
	help
	  Enable module integrity check during boot using MD5.

comment "GZIP/ZLIB decompression not available due to missing zlib package"
	depends on !HAVE_BIDPC_ZLIB

source "pkg/drivers/bootstrap/server/src/platform/Kconfig.s32z"

source "pkg/drivers/bootstrap/server/src/platform/Kconfig.s32n"

source "pkg/drivers/bootstrap/server/src/platform/Kconfig.s32k5"

endmenu
```

## pkg/drivers/bootstrap/server/src/platform/Kconfig.s32n
```kconfig
# Copyright 2023-2025 NXP
# SPDX-License-Identifier: MIT
#
# S32N platform configuration
# Disabled: choice blocks incompatible with kconfig 6.18+
# Original upstream uses if/choice syntax not supported by newer kconfig parsers.

if PLATFORM_TYPE_s32n5

config BOOTSTRAP_PF_S32N_DYN_ALLOC_OVERRIDE
	bool "Override dynamic allocation region"
	help
	  Specify region of dynamic allocations manually. By default the whole
	  CRAM region of the respective RTU is used.

config BOOTSTRAP_PF_S32N_DYN_ALLOC_START
	hex "Dynamic alloction base address"
	depends on BOOTSTRAP_PF_S32N_DYN_ALLOC_OVERRIDE
	default 0x39580000
	help
	  Lower address of region where dynamic allocations are done. This
	  includes the multiboot information and possibly dynamic placement
	  of the initial tasks.

config BOOTSTRAP_PF_S32N_DYN_ALLOC_END
	hex "Dynamic allocations end address"
	depends on BOOTSTRAP_PF_S32N_DYN_ALLOC_OVERRIDE
	default 0x39ffffff
	help
	  Upper address (inclusive) of region where dynamic allocations are
	  done.

endif # PLATFORM_TYPE_s32n5
```

## pkg/drivers/i2c-driver/Kconfig.L4
```kconfig
menu "I2C driver"

config I2C_DRIVER_RPI4
	bool "RPI4"
	default y
	help
	  Include support for the Raspberry Pi 4 I2C controller.

config I2C_DRIVER_IMX8
	bool "i.MX8"
	default y
	help
	  Include support for the i.MX8 I2C controller.

config I2C_DRIVER_AM335X
	bool "AM335x (BeagleBone Black)"
	default y
	help
	  Include support for the TI AM335x I2C controller
	  (BeagleBone Black and compatible boards).

endmenu
```

## pkg/drivers/rtc/Kconfig.L4
```kconfig
menu "RTC"

config RTC_DS3231
        bool "DS3231"
        depends on HAVE_BIDPC_I2C_DRIVER

config RTC_PCF85063A
        bool "NXP PCF85063A RTC chip"
        depends on HAVE_BIDPC_I2C_DRIVER

config RTC_AM335X
        bool "AM335x on-chip RTC (BeagleBone Black)"
        default y
        help
          On-chip RTC module of the TI AM335x SoC.
          Uses MMIO registers at 0x44E3E000, no I2C required.

comment "Some RTC drivers might be unavailable due to missing i2c-driver package."
        depends on !HAVE_BIDPC_I2C_DRIVER

endmenu
```

## pkg/drivers/spi-driver/Kconfig.L4
```kconfig
menu "SPI driver"

config SPI_DRIVER_RPI4
	bool "RPI4"
	default y
	help
	  Include support for the Raspberry Pi 4 SPI controller (BCM2835).

config SPI_DRIVER_IMX8
	bool "i.MX8"
	default y
	help
	  Include support for the i.MX8 eCSPI controller.

config SPI_DRIVER_AM335X
	bool "AM335x (BeagleBone Black)"
	default y
	help
	  Include support for the TI AM335x McSPI controller
	  (BeagleBone Black and compatible boards).

endmenu
```

## pkg/mcp2515/Kconfig.L4
```kconfig
menu "MCP2515 CAN controller driver"

config MCP2515
	bool "Enable MCP2515 CAN controller driver (SPI)"
	default y
	help
	  Microchip MCP2515 standalone CAN 2.0A/B controller.
	  Communicates with the host over SPI and supports standard
	  (11-bit) and extended (29-bit) CAN frames.

if MCP2515

choice
	prompt "Crystal oscillator frequency"
	default MCP2515_OSC_8MHZ

config MCP2515_OSC_8MHZ
	bool "8 MHz"
	help
	  8 MHz crystal on the MCP2515 XTAL pins.

config MCP2515_OSC_16MHZ
	bool "16 MHz"
	help
	  16 MHz crystal on the MCP2515 XTAL pins.

endchoice

choice
	prompt "Default CAN bit rate"
	default MCP2515_BITRATE_500K

config MCP2515_BITRATE_125K
	bool "125 kbps"

config MCP2515_BITRATE_250K
	bool "250 kbps"

config MCP2515_BITRATE_500K
	bool "500 kbps"

config MCP2515_BITRATE_1000K
	bool "1000 kbps"
	help
	  1 Mbps is only available with an 8 MHz crystal using a 4-TQ
	  bit time, or a 16 MHz crystal using an 8-TQ bit time.

endchoice

config MCP2515_SPI_CS
	int "SPI chip-select (CS) number"
	range 0 3
	default 0
	help
	  Which SPI CS line the MCP2515 /CS pin is connected to.

config MCP2515_SPI_SPEED_KHZ
	int "SPI clock speed (kHz)"
	range 100 10000
	default 4000
	help
	  SPI bus clock in kHz.  MCP2515 supports up to 10 MHz;
	  a conservative 4 MHz default works with long wires.

config MCP2515_BUILD_EXAMPLE
	bool "Build mcp2515-example demo program"
	default y
	help
	  Build the loopback demonstration that sends and receives
	  a CAN frame using the MCP2515 loopback mode.

endif # MCP2515

endmenu
```

## pkg/tef6686hn/Kconfig.L4
```kconfig
menu "TEF6686HN car radio tuner driver"

config TEF6686HN
	bool "Enable TEF6686HN radio tuner driver (I2C)"
	default y
	help
	  NXP TEF6686HN software-defined car radio tuner.
	  Supports FM (64–108 MHz), MW (522–1710 kHz) and LW (144–288 kHz).
	  Communicates over I2C at address 0x1C.

if TEF6686HN

config TEF6686HN_I2C_ADDR
	hex "I2C device address (7-bit)"
	default 0x1C
	help
	  7-bit I2C address of the TEF6686HN.  The default is 0x1C; some
	  boards connect the ADDR pin differently.

config TEF6686HN_FM_MIN_KHZ
	int "FM band lower limit (kHz)"
	default 87500
	help
	  Lowest FM frequency in kHz.  Use 64000 for Japan band,
	  87500 for standard OIRT/CCIR band.

config TEF6686HN_FM_MAX_KHZ
	int "FM band upper limit (kHz)"
	default 108000

config TEF6686HN_BUILD_EXAMPLE
	bool "Build tef6686hn-example demo program"
	default y
	help
	  Build a demonstration that scans a few FM/AM frequencies,
	  reads signal quality, and prints the results.

endif # TEF6686HN

endmenu
```
